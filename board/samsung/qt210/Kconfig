## board/samsung/qt210/Kconfig
```kconfig
if TARGET_QT210

config SYS_BOARD
	default "qt210"

config SYS_VENDOR
	default "samsung"

config SYS_SOC
	default "s5pc1xx"

config SYS_CONFIG_NAME
	default "qt210"

endif
```
